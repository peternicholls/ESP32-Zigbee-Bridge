## sdkconfig.defaults
```kconfig
# ESP32-C6 Zigbee Bridge - Default SDK Configuration
#
# This file contains default Kconfig settings for the project.
# These are applied when building for the first time or after a full clean.

# Target: ESP32-C6
CONFIG_IDF_TARGET="esp32c6"

# ----- CPU and Memory -----
CONFIG_ESP_DEFAULT_CPU_FREQ_MHZ_160=y
# Main task hosts Zigbee stack callbacks and shell; requires 32KB stack
CONFIG_ESP_MAIN_TASK_STACK_SIZE=32768

# ----- Flash -----
CONFIG_ESPTOOLPY_FLASHSIZE_4MB=y
CONFIG_PARTITION_TABLE_CUSTOM=y
CONFIG_PARTITION_TABLE_CUSTOM_FILENAME="partitions.csv"

# ----- Wi-Fi -----
CONFIG_ESP_WIFI_ENABLED=y
CONFIG_ESP_WIFI_STATIC_RX_BUFFER_NUM=10
CONFIG_ESP_WIFI_DYNAMIC_RX_BUFFER_NUM=32
CONFIG_ESP_WIFI_AMPDU_TX_ENABLED=y
CONFIG_ESP_WIFI_AMPDU_RX_ENABLED=y

# ----- Zigbee -----
CONFIG_ZB_ENABLED=y
CONFIG_ZB_COORDINATOR=y
CONFIG_ZB_RADIO_MODE_NATIVE=y
CONFIG_ZB_ZCZR=y

# ----- IEEE 802.15.4 -----
CONFIG_IEEE802154_ENABLED=y

# ----- NVS (Persistence) -----
CONFIG_NVS_ENCRYPTION=n

# ----- UART Console (with USB Serial JTAG as secondary for input) -----
CONFIG_ESP_CONSOLE_UART_DEFAULT=y
CONFIG_ESP_CONSOLE_SECONDARY_USB_SERIAL_JTAG=y
CONFIG_ESP_CONSOLE_UART_BAUDRATE=115200

# ----- Logging -----
CONFIG_LOG_DEFAULT_LEVEL_INFO=y
CONFIG_LOG_MAXIMUM_LEVEL_DEBUG=y

# ----- FreeRTOS -----
CONFIG_FREERTOS_HZ=1000
CONFIG_FREERTOS_TIMER_TASK_STACK_DEPTH=3072

# ----- MQTT -----
CONFIG_MQTT_PROTOCOL_311=y
CONFIG_MQTT_TRANSPORT_SSL=y
CONFIG_MQTT_TRANSPORT_WEBSOCKET=n

# ----- lwIP (Network Stack) -----
CONFIG_LWIP_MAX_SOCKETS=16
CONFIG_LWIP_SO_RCVBUF=y

# ----- Power Management -----
CONFIG_PM_ENABLE=n

# ----- Watchdog -----
CONFIG_ESP_TASK_WDT_EN=y
CONFIG_ESP_TASK_WDT_TIMEOUT_S=10

# ----- Compiler Optimization -----
CONFIG_COMPILER_OPTIMIZATION_SIZE=y
```
